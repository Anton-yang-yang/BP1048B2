/* This file is generated by nds_ldsag (version (2017-01-11) ). */
ENTRY(_start)
INCLUDE "..\middleware\flashboot\funlist.hhh"
SECTIONS
{
	PROVIDE (__executable_start = 0x00000);
	NDS_SAG_LMA_EILM = 0x00000 ;
	EILM_BEGIN = NDS_SAG_LMA_EILM;
	. = 0x00000;
	".nds32_init_*flash_boot.o" 	: { KEEP(*flash_boot.o(.nds32_init )) }
	".interp_*flash_boot.o" 	: { KEEP(*flash_boot.o(.interp )) }
	".hash_*flash_boot.o" 	: { KEEP(*flash_boot.o(.hash )) }
	".dynsym_*flash_boot.o" 	: { KEEP(*flash_boot.o(.dynsym )) }
	".dynstr_*flash_boot.o" 	: { KEEP(*flash_boot.o(.dynstr )) }
	".gnu.version_*flash_boot.o" 	: { KEEP(*flash_boot.o(.gnu.version )) }
	".gnu.version_d_*flash_boot.o" 	: { KEEP(*flash_boot.o(.gnu.version_d )) }
	".gnu.version_r_*flash_boot.o" 	: { KEEP(*flash_boot.o(.gnu.version_r )) }
	".rel.init_*flash_boot.o" 	: { KEEP(*flash_boot.o(.rel.init )) }
	".rela.init_*flash_boot.o" 	: { KEEP(*flash_boot.o(.rela.init )) }
	".rel.text_*flash_boot.o" 	: { KEEP(*flash_boot.o(.rel.text .rel.text.* .rel.gnu.linkonce.t.* )) }
	".rela.text_*flash_boot.o" 	: { KEEP(*flash_boot.o(.rela.text .rela.text.* .rela.gnu.linkonce.t.* )) }
	".rel.fini_*flash_boot.o" 	: { KEEP(*flash_boot.o(.rel.fini )) }
	".rela.fini_*flash_boot.o" 	: { KEEP(*flash_boot.o(.rela.fini )) }
	".rel.rodata_*flash_boot.o" 	: { KEEP(*flash_boot.o(.rel.rodata .rel.rodata.* .rel.gnu.linkonce.r.* )) }
	".rela.rodata_*flash_boot.o" 	: { KEEP(*flash_boot.o(.rela.rodata .rela.rodata.* .rela.gnu.linkonce.r.* )) }
	".rel.data.rel.ro_*flash_boot.o" 	: { KEEP(*flash_boot.o(.rel.data.rel.ro* )) }
	".rela.data.rel.ro_*flash_boot.o" 	: { KEEP(*flash_boot.o(.rel.data.rel.ro* )) }
	".rel.data_*flash_boot.o" 	: { KEEP(*flash_boot.o(.rel.data .rel.data.* .rel.gnu.linkonce.d.* )) }
	".rela.data_*flash_boot.o" 	: { KEEP(*flash_boot.o(.rela.data .rela.data.* .rela.gnu.linkonce.d.* )) }
	".rel.tdata_*flash_boot.o" 	: { KEEP(*flash_boot.o(.rel.tdata .rel.tdata.* .rel.gnu.linkonce.td.* )) }
	".rela.tdata_*flash_boot.o" 	: { KEEP(*flash_boot.o(.rela.tdata .rela.tdata.* .rela.gnu.linkonce.td.* )) }
	".rel.tbss_*flash_boot.o" 	: { KEEP(*flash_boot.o(.rel.tbss .rel.tbss.* .rel.gnu.linkonce.tb.* )) }
	".rela.tbss_*flash_boot.o" 	: { KEEP(*flash_boot.o(.rela.tbss .rela.tbss.* .rela.gnu.linkonce.tb.* )) }
	".rel.ctors_*flash_boot.o" 	: { KEEP(*flash_boot.o(.rel.ctors )) }
	".rela.ctors_*flash_boot.o" 	: { KEEP(*flash_boot.o(.rela.ctors )) }
	".rel.dtors_*flash_boot.o" 	: { KEEP(*flash_boot.o(.rel.dtors )) }
	".rela.dtors_*flash_boot.o" 	: { KEEP(*flash_boot.o(.rela.dtors )) }
	".rela.dyn_*flash_boot.o" 	: { KEEP(*flash_boot.o(rela.dyn )) KEEP(*flash_boot.o(.rela__libc_subfreeres )) KEEP(*flash_boot.o(.rela__libc_atexit )) KEEP(*flash_boot.o(.rela__libc_thread_subfreeres )) KEEP(*flash_boot.o(.rela.init_array )) KEEP(*flash_boot.o(.rela.fini_array )) }
	".rel.got_*flash_boot.o" 	: { KEEP(*flash_boot.o(.rel.got )) }
	".rela.got_*flash_boot.o" 	: { KEEP(*flash_boot.o(.rela.got )) }
	".rel.sdata_*flash_boot.o" 	: { KEEP(*flash_boot.o(.rel.sdata .rel.sdata.* .rel.gnu.linkonce.s.* )) }
	".rela.sdata_*flash_boot.o" 	: { KEEP(*flash_boot.o(.rela.sdata .rela.sdata.* .rela.gnu.linkonce.s.* )) }
	".rel.sbss_*flash_boot.o" 	: { KEEP(*flash_boot.o(.rel.sbss .rel.sbss.* .rel.gnu.linkonce.sb.* )) }
	".rela.sbss_*flash_boot.o" 	: { KEEP(*flash_boot.o(.rela.sbss .rela.sbss.* .rela.gnu.linkonce.sb.* )) }
	".rel.sdata2_*flash_boot.o" 	: { KEEP(*flash_boot.o(.rel.sdata2 .rel.sdata2.* .rel.gnu.linkonce.s2.* )) }
	".rela.sdata2_*flash_boot.o" 	: { KEEP(*flash_boot.o(.rela.sdata2 .rela.sdata2.* .rela.gnu.linkonce.s2.* )) }
	".rel.sbss2_*flash_boot.o" 	: { KEEP(*flash_boot.o(.rel.sbss2 .rel.sbss2.* .rel.gnu.linkonce.sb2.* )) }
	".rela.sbss2_*flash_boot.o" 	: { KEEP(*flash_boot.o(.rela.sbss2 .rela.sbss2.* .rela.gnu.linkonce.sb2.* )) }
	".rel.bss_*flash_boot.o" 	: { KEEP(*flash_boot.o(.rel.bss .rel.bss.* .rel.gnu.linkonce.b.* )) }
	".rela.bss_*flash_boot.o" 	: { KEEP(*flash_boot.o(.rela.bss .rela.bss.* .rela.gnu.linkonce.b.* )) }
	".rel.plt_*flash_boot.o" 	: { KEEP(*flash_boot.o(.rel.plt )) }
	".rela.plt_*flash_boot.o" 	: { KEEP(*flash_boot.o(.rela.plt )) }
	".init_*flash_boot.o" 	: { KEEP(*flash_boot.o(.init )) }
	".plt_*flash_boot.o" 	: { KEEP(*flash_boot.o(.plt )) }
	".text_*flash_boot.o" 	: { KEEP(*flash_boot.o(.text .stub .text.* .gnu.linkonce.t.* )) KEEP(*flash_boot.o(.text.*personality* )) KEEP(*flash_boot.o(.gnu.warning )) . = ALIGN(4); }
	".fini_*flash_boot.o" 	: { KEEP(*flash_boot.o(.fini )) }
	".ex9.itable_*flash_boot.o" 	: { KEEP(*flash_boot.o(.ex9.itable )) }
	PROVIDE (__etext = .);
	PROVIDE (_etext = .);
	PROVIDE (etext = .);
	".rodata_*flash_boot.o" 	: { KEEP(*flash_boot.o(.rodata .rodata.* .gnu.linkonce.r.* )) }
	".rodata1_*flash_boot.o" 	: { KEEP(*flash_boot.o(.rodata1 )) }
	".sdata2_*flash_boot.o" 	: { KEEP(*flash_boot.o(.sdata2 .sdata2.* .gnu.linkonce.s2.* )) }
	".sbss2_*flash_boot.o" 	: { KEEP(*flash_boot.o(.sbss2 .sbss2.* .gnu.linkonce.sb2.* )) }
	".eh_frame_hdr_*flash_boot.o" 	: { KEEP(*flash_boot.o(.eh_frame_hdr )) }
	__sdk_code_start =  LOADADDR (.vector);
	.vector 	: { KEEP(*(.vector )) }
	.stub_section 	: { KEEP(*(.stub_section )) }
	".nds32_init_*tws_time_sync.o" 	: { KEEP(*tws_time_sync.o(.nds32_init )) }
	".interp_*tws_time_sync.o" 	: { KEEP(*tws_time_sync.o(.interp )) }
	".hash_*tws_time_sync.o" 	: { KEEP(*tws_time_sync.o(.hash )) }
	".dynsym_*tws_time_sync.o" 	: { KEEP(*tws_time_sync.o(.dynsym )) }
	".dynstr_*tws_time_sync.o" 	: { KEEP(*tws_time_sync.o(.dynstr )) }
	".gnu.version_*tws_time_sync.o" 	: { KEEP(*tws_time_sync.o(.gnu.version )) }
	".gnu.version_d_*tws_time_sync.o" 	: { KEEP(*tws_time_sync.o(.gnu.version_d )) }
	".gnu.version_r_*tws_time_sync.o" 	: { KEEP(*tws_time_sync.o(.gnu.version_r )) }
	".rel.init_*tws_time_sync.o" 	: { KEEP(*tws_time_sync.o(.rel.init )) }
	".rela.init_*tws_time_sync.o" 	: { KEEP(*tws_time_sync.o(.rela.init )) }
	".rel.text_*tws_time_sync.o" 	: { KEEP(*tws_time_sync.o(.rel.text .rel.text.* .rel.gnu.linkonce.t.* )) }
	".rela.text_*tws_time_sync.o" 	: { KEEP(*tws_time_sync.o(.rela.text .rela.text.* .rela.gnu.linkonce.t.* )) }
	".rel.fini_*tws_time_sync.o" 	: { KEEP(*tws_time_sync.o(.rel.fini )) }
	".rela.fini_*tws_time_sync.o" 	: { KEEP(*tws_time_sync.o(.rela.fini )) }
	".rel.rodata_*tws_time_sync.o" 	: { KEEP(*tws_time_sync.o(.rel.rodata .rel.rodata.* .rel.gnu.linkonce.r.* )) }
	".rela.rodata_*tws_time_sync.o" 	: { KEEP(*tws_time_sync.o(.rela.rodata .rela.rodata.* .rela.gnu.linkonce.r.* )) }
	".rel.data.rel.ro_*tws_time_sync.o" 	: { KEEP(*tws_time_sync.o(.rel.data.rel.ro* )) }
	".rela.data.rel.ro_*tws_time_sync.o" 	: { KEEP(*tws_time_sync.o(.rel.data.rel.ro* )) }
	".rel.data_*tws_time_sync.o" 	: { KEEP(*tws_time_sync.o(.rel.data .rel.data.* .rel.gnu.linkonce.d.* )) }
	".rela.data_*tws_time_sync.o" 	: { KEEP(*tws_time_sync.o(.rela.data .rela.data.* .rela.gnu.linkonce.d.* )) }
	".rel.tdata_*tws_time_sync.o" 	: { KEEP(*tws_time_sync.o(.rel.tdata .rel.tdata.* .rel.gnu.linkonce.td.* )) }
	".rela.tdata_*tws_time_sync.o" 	: { KEEP(*tws_time_sync.o(.rela.tdata .rela.tdata.* .rela.gnu.linkonce.td.* )) }
	".rel.tbss_*tws_time_sync.o" 	: { KEEP(*tws_time_sync.o(.rel.tbss .rel.tbss.* .rel.gnu.linkonce.tb.* )) }
	".rela.tbss_*tws_time_sync.o" 	: { KEEP(*tws_time_sync.o(.rela.tbss .rela.tbss.* .rela.gnu.linkonce.tb.* )) }
	".rel.ctors_*tws_time_sync.o" 	: { KEEP(*tws_time_sync.o(.rel.ctors )) }
	".rela.ctors_*tws_time_sync.o" 	: { KEEP(*tws_time_sync.o(.rela.ctors )) }
	".rel.dtors_*tws_time_sync.o" 	: { KEEP(*tws_time_sync.o(.rel.dtors )) }
	".rela.dtors_*tws_time_sync.o" 	: { KEEP(*tws_time_sync.o(.rela.dtors )) }
	".rela.dyn_*tws_time_sync.o" 	: { KEEP(*tws_time_sync.o(rela.dyn )) KEEP(*tws_time_sync.o(.rela__libc_subfreeres )) KEEP(*tws_time_sync.o(.rela__libc_atexit )) KEEP(*tws_time_sync.o(.rela__libc_thread_subfreeres )) KEEP(*tws_time_sync.o(.rela.init_array )) KEEP(*tws_time_sync.o(.rela.fini_array )) }
	".rel.got_*tws_time_sync.o" 	: { KEEP(*tws_time_sync.o(.rel.got )) }
	".rela.got_*tws_time_sync.o" 	: { KEEP(*tws_time_sync.o(.rela.got )) }
	".rel.sdata_*tws_time_sync.o" 	: { KEEP(*tws_time_sync.o(.rel.sdata .rel.sdata.* .rel.gnu.linkonce.s.* )) }
	".rela.sdata_*tws_time_sync.o" 	: { KEEP(*tws_time_sync.o(.rela.sdata .rela.sdata.* .rela.gnu.linkonce.s.* )) }
	".rel.sbss_*tws_time_sync.o" 	: { KEEP(*tws_time_sync.o(.rel.sbss .rel.sbss.* .rel.gnu.linkonce.sb.* )) }
	".rela.sbss_*tws_time_sync.o" 	: { KEEP(*tws_time_sync.o(.rela.sbss .rela.sbss.* .rela.gnu.linkonce.sb.* )) }
	".rel.sdata2_*tws_time_sync.o" 	: { KEEP(*tws_time_sync.o(.rel.sdata2 .rel.sdata2.* .rel.gnu.linkonce.s2.* )) }
	".rela.sdata2_*tws_time_sync.o" 	: { KEEP(*tws_time_sync.o(.rela.sdata2 .rela.sdata2.* .rela.gnu.linkonce.s2.* )) }
	".rel.sbss2_*tws_time_sync.o" 	: { KEEP(*tws_time_sync.o(.rel.sbss2 .rel.sbss2.* .rel.gnu.linkonce.sb2.* )) }
	".rela.sbss2_*tws_time_sync.o" 	: { KEEP(*tws_time_sync.o(.rela.sbss2 .rela.sbss2.* .rela.gnu.linkonce.sb2.* )) }
	".rel.bss_*tws_time_sync.o" 	: { KEEP(*tws_time_sync.o(.rel.bss .rel.bss.* .rel.gnu.linkonce.b.* )) }
	".rela.bss_*tws_time_sync.o" 	: { KEEP(*tws_time_sync.o(.rela.bss .rela.bss.* .rela.gnu.linkonce.b.* )) }
	".rel.plt_*tws_time_sync.o" 	: { KEEP(*tws_time_sync.o(.rel.plt )) }
	".rela.plt_*tws_time_sync.o" 	: { KEEP(*tws_time_sync.o(.rela.plt )) }
	".init_*tws_time_sync.o" 	: { KEEP(*tws_time_sync.o(.init )) }
	".plt_*tws_time_sync.o" 	: { KEEP(*tws_time_sync.o(.plt )) }
	".text_*tws_time_sync.o" 	: { KEEP(*tws_time_sync.o(.text .stub .text.* .gnu.linkonce.t.* )) KEEP(*tws_time_sync.o(.text.*personality* )) KEEP(*tws_time_sync.o(.gnu.warning )) . = ALIGN(4); }
	".fini_*tws_time_sync.o" 	: { KEEP(*tws_time_sync.o(.fini )) }
	".ex9.itable_*tws_time_sync.o" 	: { KEEP(*tws_time_sync.o(.ex9.itable )) }
	PROVIDE (__etext = .);
	PROVIDE (_etext = .);
	PROVIDE (etext = .);
	".rodata_*tws_time_sync.o" 	: { KEEP(*tws_time_sync.o(.rodata .rodata.* .gnu.linkonce.r.* )) }
	".rodata1_*tws_time_sync.o" 	: { KEEP(*tws_time_sync.o(.rodata1 )) }
	".sdata2_*tws_time_sync.o" 	: { KEEP(*tws_time_sync.o(.sdata2 .sdata2.* .gnu.linkonce.s2.* )) }
	".sbss2_*tws_time_sync.o" 	: { KEEP(*tws_time_sync.o(.sbss2 .sbss2.* .gnu.linkonce.sb2.* )) }
	".eh_frame_hdr_*tws_time_sync.o" 	: { KEEP(*tws_time_sync.o(.eh_frame_hdr )) }
	".nds32_init_*reg_access.o" 	: { KEEP(*reg_access.o(.nds32_init )) }
	".interp_*reg_access.o" 	: { KEEP(*reg_access.o(.interp )) }
	".hash_*reg_access.o" 	: { KEEP(*reg_access.o(.hash )) }
	".dynsym_*reg_access.o" 	: { KEEP(*reg_access.o(.dynsym )) }
	".dynstr_*reg_access.o" 	: { KEEP(*reg_access.o(.dynstr )) }
	".gnu.version_*reg_access.o" 	: { KEEP(*reg_access.o(.gnu.version )) }
	".gnu.version_d_*reg_access.o" 	: { KEEP(*reg_access.o(.gnu.version_d )) }
	".gnu.version_r_*reg_access.o" 	: { KEEP(*reg_access.o(.gnu.version_r )) }
	".rel.init_*reg_access.o" 	: { KEEP(*reg_access.o(.rel.init )) }
	".rela.init_*reg_access.o" 	: { KEEP(*reg_access.o(.rela.init )) }
	".rel.text_*reg_access.o" 	: { KEEP(*reg_access.o(.rel.text .rel.text.* .rel.gnu.linkonce.t.* )) }
	".rela.text_*reg_access.o" 	: { KEEP(*reg_access.o(.rela.text .rela.text.* .rela.gnu.linkonce.t.* )) }
	".rel.fini_*reg_access.o" 	: { KEEP(*reg_access.o(.rel.fini )) }
	".rela.fini_*reg_access.o" 	: { KEEP(*reg_access.o(.rela.fini )) }
	".rel.rodata_*reg_access.o" 	: { KEEP(*reg_access.o(.rel.rodata .rel.rodata.* .rel.gnu.linkonce.r.* )) }
	".rela.rodata_*reg_access.o" 	: { KEEP(*reg_access.o(.rela.rodata .rela.rodata.* .rela.gnu.linkonce.r.* )) }
	".rel.data.rel.ro_*reg_access.o" 	: { KEEP(*reg_access.o(.rel.data.rel.ro* )) }
	".rela.data.rel.ro_*reg_access.o" 	: { KEEP(*reg_access.o(.rel.data.rel.ro* )) }
	".rel.data_*reg_access.o" 	: { KEEP(*reg_access.o(.rel.data .rel.data.* .rel.gnu.linkonce.d.* )) }
	".rela.data_*reg_access.o" 	: { KEEP(*reg_access.o(.rela.data .rela.data.* .rela.gnu.linkonce.d.* )) }
	".rel.tdata_*reg_access.o" 	: { KEEP(*reg_access.o(.rel.tdata .rel.tdata.* .rel.gnu.linkonce.td.* )) }
	".rela.tdata_*reg_access.o" 	: { KEEP(*reg_access.o(.rela.tdata .rela.tdata.* .rela.gnu.linkonce.td.* )) }
	".rel.tbss_*reg_access.o" 	: { KEEP(*reg_access.o(.rel.tbss .rel.tbss.* .rel.gnu.linkonce.tb.* )) }
	".rela.tbss_*reg_access.o" 	: { KEEP(*reg_access.o(.rela.tbss .rela.tbss.* .rela.gnu.linkonce.tb.* )) }
	".rel.ctors_*reg_access.o" 	: { KEEP(*reg_access.o(.rel.ctors )) }
	".rela.ctors_*reg_access.o" 	: { KEEP(*reg_access.o(.rela.ctors )) }
	".rel.dtors_*reg_access.o" 	: { KEEP(*reg_access.o(.rel.dtors )) }
	".rela.dtors_*reg_access.o" 	: { KEEP(*reg_access.o(.rela.dtors )) }
	".rela.dyn_*reg_access.o" 	: { KEEP(*reg_access.o(rela.dyn )) KEEP(*reg_access.o(.rela__libc_subfreeres )) KEEP(*reg_access.o(.rela__libc_atexit )) KEEP(*reg_access.o(.rela__libc_thread_subfreeres )) KEEP(*reg_access.o(.rela.init_array )) KEEP(*reg_access.o(.rela.fini_array )) }
	".rel.got_*reg_access.o" 	: { KEEP(*reg_access.o(.rel.got )) }
	".rela.got_*reg_access.o" 	: { KEEP(*reg_access.o(.rela.got )) }
	".rel.sdata_*reg_access.o" 	: { KEEP(*reg_access.o(.rel.sdata .rel.sdata.* .rel.gnu.linkonce.s.* )) }
	".rela.sdata_*reg_access.o" 	: { KEEP(*reg_access.o(.rela.sdata .rela.sdata.* .rela.gnu.linkonce.s.* )) }
	".rel.sbss_*reg_access.o" 	: { KEEP(*reg_access.o(.rel.sbss .rel.sbss.* .rel.gnu.linkonce.sb.* )) }
	".rela.sbss_*reg_access.o" 	: { KEEP(*reg_access.o(.rela.sbss .rela.sbss.* .rela.gnu.linkonce.sb.* )) }
	".rel.sdata2_*reg_access.o" 	: { KEEP(*reg_access.o(.rel.sdata2 .rel.sdata2.* .rel.gnu.linkonce.s2.* )) }
	".rela.sdata2_*reg_access.o" 	: { KEEP(*reg_access.o(.rela.sdata2 .rela.sdata2.* .rela.gnu.linkonce.s2.* )) }
	".rel.sbss2_*reg_access.o" 	: { KEEP(*reg_access.o(.rel.sbss2 .rel.sbss2.* .rel.gnu.linkonce.sb2.* )) }
	".rela.sbss2_*reg_access.o" 	: { KEEP(*reg_access.o(.rela.sbss2 .rela.sbss2.* .rela.gnu.linkonce.sb2.* )) }
	".rel.bss_*reg_access.o" 	: { KEEP(*reg_access.o(.rel.bss .rel.bss.* .rel.gnu.linkonce.b.* )) }
	".rela.bss_*reg_access.o" 	: { KEEP(*reg_access.o(.rela.bss .rela.bss.* .rela.gnu.linkonce.b.* )) }
	".rel.plt_*reg_access.o" 	: { KEEP(*reg_access.o(.rel.plt )) }
	".rela.plt_*reg_access.o" 	: { KEEP(*reg_access.o(.rela.plt )) }
	".init_*reg_access.o" 	: { KEEP(*reg_access.o(.init )) }
	".plt_*reg_access.o" 	: { KEEP(*reg_access.o(.plt )) }
	".text_*reg_access.o" 	: { KEEP(*reg_access.o(.text .stub .text.* .gnu.linkonce.t.* )) KEEP(*reg_access.o(.text.*personality* )) KEEP(*reg_access.o(.gnu.warning )) . = ALIGN(4); }
	".fini_*reg_access.o" 	: { KEEP(*reg_access.o(.fini )) }
	".ex9.itable_*reg_access.o" 	: { KEEP(*reg_access.o(.ex9.itable )) }
	PROVIDE (__etext = .);
	PROVIDE (_etext = .);
	PROVIDE (etext = .);
	".rodata_*reg_access.o" 	: { KEEP(*reg_access.o(.rodata .rodata.* .gnu.linkonce.r.* )) }
	".rodata1_*reg_access.o" 	: { KEEP(*reg_access.o(.rodata1 )) }
	".sdata2_*reg_access.o" 	: { KEEP(*reg_access.o(.sdata2 .sdata2.* .gnu.linkonce.s2.* )) }
	".sbss2_*reg_access.o" 	: { KEEP(*reg_access.o(.sbss2 .sbss2.* .gnu.linkonce.sb2.* )) }
	".eh_frame_hdr_*reg_access.o" 	: { KEEP(*reg_access.o(.eh_frame_hdr )) }
	".nds32_init_*co_utils.o" 	: { KEEP(*co_utils.o(.nds32_init )) }
	".interp_*co_utils.o" 	: { KEEP(*co_utils.o(.interp )) }
	".hash_*co_utils.o" 	: { KEEP(*co_utils.o(.hash )) }
	".dynsym_*co_utils.o" 	: { KEEP(*co_utils.o(.dynsym )) }
	".dynstr_*co_utils.o" 	: { KEEP(*co_utils.o(.dynstr )) }
	".gnu.version_*co_utils.o" 	: { KEEP(*co_utils.o(.gnu.version )) }
	".gnu.version_d_*co_utils.o" 	: { KEEP(*co_utils.o(.gnu.version_d )) }
	".gnu.version_r_*co_utils.o" 	: { KEEP(*co_utils.o(.gnu.version_r )) }
	".rel.init_*co_utils.o" 	: { KEEP(*co_utils.o(.rel.init )) }
	".rela.init_*co_utils.o" 	: { KEEP(*co_utils.o(.rela.init )) }
	".rel.text_*co_utils.o" 	: { KEEP(*co_utils.o(.rel.text .rel.text.* .rel.gnu.linkonce.t.* )) }
	".rela.text_*co_utils.o" 	: { KEEP(*co_utils.o(.rela.text .rela.text.* .rela.gnu.linkonce.t.* )) }
	".rel.fini_*co_utils.o" 	: { KEEP(*co_utils.o(.rel.fini )) }
	".rela.fini_*co_utils.o" 	: { KEEP(*co_utils.o(.rela.fini )) }
	".rel.rodata_*co_utils.o" 	: { KEEP(*co_utils.o(.rel.rodata .rel.rodata.* .rel.gnu.linkonce.r.* )) }
	".rela.rodata_*co_utils.o" 	: { KEEP(*co_utils.o(.rela.rodata .rela.rodata.* .rela.gnu.linkonce.r.* )) }
	".rel.data.rel.ro_*co_utils.o" 	: { KEEP(*co_utils.o(.rel.data.rel.ro* )) }
	".rela.data.rel.ro_*co_utils.o" 	: { KEEP(*co_utils.o(.rel.data.rel.ro* )) }
	".rel.data_*co_utils.o" 	: { KEEP(*co_utils.o(.rel.data .rel.data.* .rel.gnu.linkonce.d.* )) }
	".rela.data_*co_utils.o" 	: { KEEP(*co_utils.o(.rela.data .rela.data.* .rela.gnu.linkonce.d.* )) }
	".rel.tdata_*co_utils.o" 	: { KEEP(*co_utils.o(.rel.tdata .rel.tdata.* .rel.gnu.linkonce.td.* )) }
	".rela.tdata_*co_utils.o" 	: { KEEP(*co_utils.o(.rela.tdata .rela.tdata.* .rela.gnu.linkonce.td.* )) }
	".rel.tbss_*co_utils.o" 	: { KEEP(*co_utils.o(.rel.tbss .rel.tbss.* .rel.gnu.linkonce.tb.* )) }
	".rela.tbss_*co_utils.o" 	: { KEEP(*co_utils.o(.rela.tbss .rela.tbss.* .rela.gnu.linkonce.tb.* )) }
	".rel.ctors_*co_utils.o" 	: { KEEP(*co_utils.o(.rel.ctors )) }
	".rela.ctors_*co_utils.o" 	: { KEEP(*co_utils.o(.rela.ctors )) }
	".rel.dtors_*co_utils.o" 	: { KEEP(*co_utils.o(.rel.dtors )) }
	".rela.dtors_*co_utils.o" 	: { KEEP(*co_utils.o(.rela.dtors )) }
	".rela.dyn_*co_utils.o" 	: { KEEP(*co_utils.o(rela.dyn )) KEEP(*co_utils.o(.rela__libc_subfreeres )) KEEP(*co_utils.o(.rela__libc_atexit )) KEEP(*co_utils.o(.rela__libc_thread_subfreeres )) KEEP(*co_utils.o(.rela.init_array )) KEEP(*co_utils.o(.rela.fini_array )) }
	".rel.got_*co_utils.o" 	: { KEEP(*co_utils.o(.rel.got )) }
	".rela.got_*co_utils.o" 	: { KEEP(*co_utils.o(.rela.got )) }
	".rel.sdata_*co_utils.o" 	: { KEEP(*co_utils.o(.rel.sdata .rel.sdata.* .rel.gnu.linkonce.s.* )) }
	".rela.sdata_*co_utils.o" 	: { KEEP(*co_utils.o(.rela.sdata .rela.sdata.* .rela.gnu.linkonce.s.* )) }
	".rel.sbss_*co_utils.o" 	: { KEEP(*co_utils.o(.rel.sbss .rel.sbss.* .rel.gnu.linkonce.sb.* )) }
	".rela.sbss_*co_utils.o" 	: { KEEP(*co_utils.o(.rela.sbss .rela.sbss.* .rela.gnu.linkonce.sb.* )) }
	".rel.sdata2_*co_utils.o" 	: { KEEP(*co_utils.o(.rel.sdata2 .rel.sdata2.* .rel.gnu.linkonce.s2.* )) }
	".rela.sdata2_*co_utils.o" 	: { KEEP(*co_utils.o(.rela.sdata2 .rela.sdata2.* .rela.gnu.linkonce.s2.* )) }
	".rel.sbss2_*co_utils.o" 	: { KEEP(*co_utils.o(.rel.sbss2 .rel.sbss2.* .rel.gnu.linkonce.sb2.* )) }
	".rela.sbss2_*co_utils.o" 	: { KEEP(*co_utils.o(.rela.sbss2 .rela.sbss2.* .rela.gnu.linkonce.sb2.* )) }
	".rel.bss_*co_utils.o" 	: { KEEP(*co_utils.o(.rel.bss .rel.bss.* .rel.gnu.linkonce.b.* )) }
	".rela.bss_*co_utils.o" 	: { KEEP(*co_utils.o(.rela.bss .rela.bss.* .rela.gnu.linkonce.b.* )) }
	".rel.plt_*co_utils.o" 	: { KEEP(*co_utils.o(.rel.plt )) }
	".rela.plt_*co_utils.o" 	: { KEEP(*co_utils.o(.rela.plt )) }
	".init_*co_utils.o" 	: { KEEP(*co_utils.o(.init )) }
	".plt_*co_utils.o" 	: { KEEP(*co_utils.o(.plt )) }
	".text_*co_utils.o" 	: { KEEP(*co_utils.o(.text .stub .text.* .gnu.linkonce.t.* )) KEEP(*co_utils.o(.text.*personality* )) KEEP(*co_utils.o(.gnu.warning )) . = ALIGN(4); }
	".fini_*co_utils.o" 	: { KEEP(*co_utils.o(.fini )) }
	".ex9.itable_*co_utils.o" 	: { KEEP(*co_utils.o(.ex9.itable )) }
	PROVIDE (__etext = .);
	PROVIDE (_etext = .);
	PROVIDE (etext = .);
	".rodata_*co_utils.o" 	: { KEEP(*co_utils.o(.rodata .rodata.* .gnu.linkonce.r.* )) }
	".rodata1_*co_utils.o" 	: { KEEP(*co_utils.o(.rodata1 )) }
	".sdata2_*co_utils.o" 	: { KEEP(*co_utils.o(.sdata2 .sdata2.* .gnu.linkonce.s2.* )) }
	".sbss2_*co_utils.o" 	: { KEEP(*co_utils.o(.sbss2 .sbss2.* .gnu.linkonce.sb2.* )) }
	".eh_frame_hdr_*co_utils.o" 	: { KEEP(*co_utils.o(.eh_frame_hdr )) }
	.deepsleep_section 	: { KEEP(*(.deepsleep_section )) }
	.startup_section 	: { KEEP(*(.startup_section )) }
	.tcm_section 	: { KEEP(*(.tcm_section )) }
	.driver.isr 	: { KEEP(*(.driver.isr )) }
	.nds32_vector 	: { KEEP(*(.nds32_vector )) KEEP(*(SORT(.nds32_vector.* ))) }
	.nds32_nmih 	: { *(.nds32_nmih ) }
	.nds32_wrh 	: { *(.nds32_wrh ) }
	.nds32_jmptbl 	: { KEEP(*(.nds32_jmptbl )) KEEP(*(SORT(.nds32_jmptbl.* ))) }
	.nds32_isr 	: { *(.nds32_isr ) }
	.nds32_init 	: { KEEP(*(.nds32_init )) }
	.interp 	: { *(.interp ) }
	.hash 	: { *(.hash ) }
	.dynsym 	: { *(.dynsym ) }
	.dynstr 	: { *(.dynstr ) }
	.gnu.version 	: { *(.gnu.version ) }
	.gnu.version_d 	: { *(.gnu.version_d ) }
	.gnu.version_r 	: { *(.gnu.version_r ) }
	.rel.init 	: { *(.rel.init ) }
	.rela.init 	: { *(.rela.init ) }
	.rel.text 	: { *(.rel.text .rel.text.* .rel.gnu.linkonce.t.* ) }
	.rela.text 	: { *(.rela.text .rela.text.* .rela.gnu.linkonce.t.* ) }
	.rel.fini 	: { *(.rel.fini ) }
	.rela.fini 	: { *(.rela.fini ) }
	.rel.rodata 	: { *(.rel.rodata .rel.rodata.* .rel.gnu.linkonce.r.* ) }
	.rela.rodata 	: { *(.rela.rodata .rela.rodata.* .rela.gnu.linkonce.r.* ) }
	.rel.data.rel.ro 	: { *(.rel.data.rel.ro* ) }
	.rela.data.rel.ro 	: { *(.rel.data.rel.ro* ) }
	.rel.data 	: { *(.rel.data .rel.data.* .rel.gnu.linkonce.d.* ) }
	.rela.data 	: { *(.rela.data .rela.data.* .rela.gnu.linkonce.d.* ) }
	.rel.tdata 	: { *(.rel.tdata .rel.tdata.* .rel.gnu.linkonce.td.* ) }
	.rela.tdata 	: { *(.rela.tdata .rela.tdata.* .rela.gnu.linkonce.td.* ) }
	.rel.tbss 	: { *(.rel.tbss .rel.tbss.* .rel.gnu.linkonce.tb.* ) }
	.rela.tbss 	: { *(.rela.tbss .rela.tbss.* .rela.gnu.linkonce.tb.* ) }
	.rel.ctors 	: { *(.rel.ctors ) }
	.rela.ctors 	: { *(.rela.ctors ) }
	.rel.dtors 	: { *(.rel.dtors ) }
	.rela.dtors 	: { *(.rela.dtors ) }
	.rela.dyn 	: { *(rela.dyn ) *(.rela__libc_subfreeres ) *(.rela__libc_atexit ) *(.rela__libc_thread_subfreeres ) *(.rela.init_array ) *(.rela.fini_array ) }
	.rel.got 	: { *(.rel.got ) }
	.rela.got 	: { *(.rela.got ) }
	.rel.sdata 	: { *(.rel.sdata .rel.sdata.* .rel.gnu.linkonce.s.* ) }
	.rela.sdata 	: { *(.rela.sdata .rela.sdata.* .rela.gnu.linkonce.s.* ) }
	.rel.sbss 	: { *(.rel.sbss .rel.sbss.* .rel.gnu.linkonce.sb.* ) }
	.rela.sbss 	: { *(.rela.sbss .rela.sbss.* .rela.gnu.linkonce.sb.* ) }
	.rel.sdata2 	: { *(.rel.sdata2 .rel.sdata2.* .rel.gnu.linkonce.s2.* ) }
	.rela.sdata2 	: { *(.rela.sdata2 .rela.sdata2.* .rela.gnu.linkonce.s2.* ) }
	.rel.sbss2 	: { *(.rel.sbss2 .rel.sbss2.* .rel.gnu.linkonce.sb2.* ) }
	.rela.sbss2 	: { *(.rela.sbss2 .rela.sbss2.* .rela.gnu.linkonce.sb2.* ) }
	.rel.bss 	: { *(.rel.bss .rel.bss.* .rel.gnu.linkonce.b.* ) }
	.rela.bss 	: { *(.rela.bss .rela.bss.* .rela.gnu.linkonce.b.* ) }
	.rel.plt 	: { *(.rel.plt ) }
	.rela.plt 	: { *(.rela.plt ) }
	.init 	: { KEEP(*(.init )) }
	.plt 	: { *(.plt ) }
	.text 	: { *(.text .stub .text.* .gnu.linkonce.t.* ) KEEP(*(.text.*personality* )) *(.gnu.warning ) . = ALIGN(4); }
	.fini 	: { KEEP(*(.fini )) }
	.ex9.itable 	: { *(.ex9.itable ) }
	PROVIDE (__etext = .);
	PROVIDE (_etext = .);
	PROVIDE (etext = .);
	.rodata 	: { *(.rodata .rodata.* .gnu.linkonce.r.* ) }
	.rodata1 	: { *(.rodata1 ) }
	.sdata2 	: { *(.sdata2 .sdata2.* .gnu.linkonce.s2.* ) }
	.sbss2 	: { *(.sbss2 .sbss2.* .gnu.linkonce.sb2.* ) }
	.eh_frame_hdr 	: { *(.eh_frame_hdr ) }
	. = . + 0;
	__ram_code_start =  LOADADDR (.ram.code);
	.ram.code 	: { *(.ram.code ) }
	__ram_code_end =  LOADADDR (.ram.code) + SIZEOF (.ram.code);
	. = . + 0;
	__rand_code_start =  LOADADDR (.rand.code);
	.rand.code 	: { *(.rand.code ) }
	__rand_code_end =  LOADADDR (.rand.code) + SIZEOF (.rand.code);
	. = . + 0;
	__ctxt_code_start =  LOADADDR (.ctxt.code);
	.ctxt.code 	: { *(.ctxt.code ) }
	__ctxt_code_end =  LOADADDR (.ctxt.code) + SIZEOF (.ctxt.code);
	. = 0x20009000;
	PROVIDE (_stack = 0x20006000);
	_SDA_BASE_ = 0x20028000;
	. = ALIGN(0x20);
	__data_lmastart =  LOADADDR (.eh_frame);
	__data_start = ADDR(.eh_frame);
	.eh_frame 	: AT(ALIGN(LOADADDR (.ctxt.code) + SIZEOF (.ctxt.code), 32))
		{ KEEP(*(.eh_frame )) }
	.gcc_except_table 	: AT(ALIGN(LOADADDR (.eh_frame) + SIZEOF (.eh_frame), ALIGNOF(.gcc_except_table)))
		{ KEEP(*(.gcc_except_table )) *(.gcc_except_table.* ) }
	.tdata 	: AT(ALIGN(LOADADDR (.gcc_except_table) + SIZEOF (.gcc_except_table), ALIGNOF(.tdata)))
		{ *(.tdata .tdata.* .gnu.linkonce.td.* ) }
	. = ALIGN(4);
	PROVIDE (__preinit_array_start = .);
	.preinit_array 	: AT(ALIGN(ALIGN(LOADADDR (.tdata) + SIZEOF (.tdata), ALIGNOF(.preinit_array)), 4))
		{ KEEP(*(.preinit_array )) }
	PROVIDE (__preinit_array_end = .);
	PROVIDE (__init_array_start = .);
	.init_array 	: AT(ALIGN(LOADADDR (.preinit_array) + SIZEOF (.preinit_array), ALIGNOF(.init_array)))
		{ KEEP(*(.init_array )) }
	PROVIDE (__init_array_end = .);
	PROVIDE (__fini_array_start = .);
	.fini_array 	: AT(ALIGN(LOADADDR (.init_array) + SIZEOF (.init_array), ALIGNOF(.fini_array)))
		{ KEEP(*(.fini_array )) }
	PROVIDE (__fini_array_end = .);
	.ctors 	: AT(ALIGN(LOADADDR (.fini_array) + SIZEOF (.fini_array), ALIGNOF(.ctors)))
		{ KEEP(*crtbegin*.o(.ctors)) KEEP(*(EXCLUDE_FILE (*crtend*.o) .ctors)) KEEP(*(SORT(.ctors.* ))) KEEP(*(.ctors )) }
	.dtors 	: AT(ALIGN(LOADADDR (.ctors) + SIZEOF (.ctors), ALIGNOF(.dtors)))
		{ KEEP(*crtbegin*.o(.dtors)) KEEP(*(EXCLUDE_FILE (*crtend*.o) .dtors)) KEEP(*(SORT(.dtors.* ))) KEEP(*(.dtors )) }
	.jcr 	: AT(ALIGN(LOADADDR (.dtors) + SIZEOF (.dtors), ALIGNOF(.jcr)))
		{ KEEP(*(.jcr )) }
	.data.rel.ro 	: AT(ALIGN(LOADADDR (.jcr) + SIZEOF (.jcr), ALIGNOF(.data.rel.ro)))
		{ *(.data.rel.ro.local ) *(.data.rel.ro* ) }
	.dynamic 	: AT(ALIGN(LOADADDR (.data.rel.ro) + SIZEOF (.data.rel.ro), ALIGNOF(.dynamic)))
		{ *(.dynamic ) }
	.data 	: AT(ALIGN(LOADADDR (.dynamic) + SIZEOF (.dynamic), ALIGNOF(.data)))
		{ *(.data .data.* .gnu.linkonce.d.* ) KEEP(*(.gnu.linkonce.d.*personality* )) SORT(CONSTRUCTORS) . = ALIGN(8); }
	.data1 	: AT(ALIGN(LOADADDR (.data) + SIZEOF (.data), ALIGNOF(.data1)))
		{ *(.data1 ) . = ALIGN(8); }
	. = ALIGN(4);
	.got 	: AT(ALIGN(ALIGN(LOADADDR (.data1) + SIZEOF (.data1), ALIGNOF(.got)), 4))
		{ *(.got.plt ) *(.got ) }
	.sdata_d 	: AT(ALIGN(LOADADDR (.got) + SIZEOF (.got), ALIGNOF(.sdata_d)))
		{ *(.sdata_d .sdata_d.* ) }
	.sdata_w 	: AT(ALIGN(LOADADDR (.sdata_d) + SIZEOF (.sdata_d), ALIGNOF(.sdata_w)))
		{ *(.sdata_w .sdata_w.* ) }
	.sdata_h 	: AT(ALIGN(LOADADDR (.sdata_w) + SIZEOF (.sdata_w), ALIGNOF(.sdata_h)))
		{ *(.sdata_h .sdata_h.* ) }
	.sdata_b 	: AT(ALIGN(LOADADDR (.sdata_h) + SIZEOF (.sdata_h), ALIGNOF(.sdata_b)))
		{ *(.sdata_b .sdata_b.* ) }
	.sdata_f 	: AT(ALIGN(LOADADDR (.sdata_b) + SIZEOF (.sdata_b), ALIGNOF(.sdata_f)))
		{ *(.sdata_f .sdata_f.* ) }
	. = ALIGN(4);
	_edata = .;
	PROVIDE (edata = .);
	__bss_start = .;
	PROVIDE (__sbss_start = .);
	PROVIDE (___sbss_start = .);
	.tbss 	: AT(ALIGN(ALIGN(LOADADDR (.sdata_f) + SIZEOF (.sdata_f), ALIGNOF(.tbss)), 4))
		{ *(.tbss .tbss.* .gnu.linkonce.tb.* ) *(.tcommon ) }
	.sbss_f 	: AT(ALIGN(LOADADDR (.tbss) + SIZEOF (.tbss), ALIGNOF(.sbss_f)))
		{ *(.sbss_f .sbss_f.* ) *(.scommon_f .scommon_f.* ) }
	.sbss_b 	: AT(ALIGN(LOADADDR (.sbss_f) + SIZEOF (.sbss_f), ALIGNOF(.sbss_b)))
		{ *(.sbss_b .sbss_b.* ) *(.scommon_b .scommon_b.* ) . = ALIGN(2); }
	.sbss_h 	: AT(ALIGN(LOADADDR (.sbss_b) + SIZEOF (.sbss_b), ALIGNOF(.sbss_h)))
		{ *(.sbss_h .sbss_h.* ) *(.scommon_h .scommon_h.* ) . = ALIGN(4); }
	.sbss_w 	: AT(ALIGN(LOADADDR (.sbss_h) + SIZEOF (.sbss_h), ALIGNOF(.sbss_w)))
		{ *(.sbss_w .sbss_w.* ) *(.scommon_w .scommon_w.* ) *(.dynsbss ) *(.scommon ) . = ALIGN(8); }
	.sbss_d 	: AT(ALIGN(LOADADDR (.sbss_w) + SIZEOF (.sbss_w), ALIGNOF(.sbss_d)))
		{ *(.sbss_d .sbss_d.* ) *(.scommon_d .scommon_d.* ) }
	.bss 	: AT(ALIGN(LOADADDR (.sbss_d) + SIZEOF (.sbss_d), ALIGNOF(.bss)))
		{ *(.dynbss ) *(.bss .bss.* .gnu.linkonce.b.* ) *(COMMON ) . = ALIGN(4); }
	PROVIDE (__sbss_end = .);
	PROVIDE (___sbss_end = .);
	. = ALIGN(4);
	_end = .;
	PROVIDE (end = .);
	EILM_SIZE = LOADADDR(.sdata_f) + SIZEOF(.sdata_f) - EILM_BEGIN;
	.stab	0 : { *(.stab) }
	.stabstr	0 : { *(.stabstr) }
	.stab.excl	0 : { *(.stab.excl) }
	.stab.exclstr	0 : { *(.stab.exclstr) }
	.stab.index	0 : { *(.stab.index) }
	.stab.indexstr	0 : { *(.stab.indexstr) }
	.note.nds32	0 : { *(.note.nds32) *(.note.nds32.*) }
	.comment	0 : { *(.comment) }
	.debug	0 : { *(.debug) }
	.line	0 : { *(.line) }
	.debug_srcinfo	0 : { *(.debug_srcinfo) }
	.debug_sfnames	0 : { *(.debug_sfnames) }
	.debug_aranges	0 : { *(.debug_aranges) }
	.debug_pubnames	0 : { *(.debug_pubnames) }
	.debug_info	0 : { *(.debug_info .gnu.linkonce.wi.*) }
	.debug_abbrev	0 : { *(.debug_abbrev) }
	.debug_line	0 : { *(.debug_line) }
	.debug_frame	0 : { *(.debug_frame) }
	.debug_str	0 : { *(.debug_str) }
	.debug_loc	0 : { *(.debug_loc) }
	.debug_macinfo	0 : { *(.debug_macinfo) }
	.debug_weaknames	0 : { *(.debug_weaknames) }
	.debug_funcnames	0 : { *(.debug_funcnames) }
	.debug_typenames	0 : { *(.debug_typenames) }
	.debug_varnames	0 : { *(.debug_varnames) }
}
ASSERT((DEFINED (_RELAX_END_) ? EILM_SIZE : 0x0)<= 0x00900000, "EILM OVERFLOW");
